## firmware/dongle/sdkconfig.defaults
```kconfig
CONFIG_ESPTOOLPY_FLASHSIZE_16MB=y
CONFIG_SPIRAM=y
CONFIG_SPIRAM_MODE_OCT=y
CONFIG_SPIRAM_TYPE_AUTO=y
CONFIG_SPIRAM_SPEED_80M=y
CONFIG_SPIRAM_USE_MALLOC=y
CONFIG_PARTITION_TABLE_CUSTOM=y
CONFIG_PARTITION_TABLE_CUSTOM_FILENAME="partitions.csv"
CONFIG_BOOTLOADER_APP_ROLLBACK_ENABLE=y
CONFIG_ESP_COREDUMP_ENABLE_TO_FLASH=y
CONFIG_AUDIO_DECODER_G722_SUPPORT=y
CONFIG_AUDIO_ENCODER_G722_SUPPORT=y
CONFIG_FREERTOS_HZ=1000
CONFIG_ESP_DEFAULT_CPU_FREQ_MHZ_240=y
CONFIG_COMPILER_OPTIMIZATION_PERF=y
CONFIG_TINYUSB_CDC_ENABLED=y
CONFIG_TINYUSB_CDC_COUNT=1
CONFIG_TINYUSB_HID_COUNT=1
CONFIG_TINYUSB_CDC_RX_BUFSIZE=512
CONFIG_TINYUSB_CDC_TX_BUFSIZE=2048
CONFIG_TINYUSB_CDC_EP_BUFSIZE=64
CONFIG_USB_DEVICE_UAC_AS_PART=y
CONFIG_UAC_SPEAKER_CHANNEL_NUM=0
CONFIG_UAC_MIC_CHANNEL_NUM=2
CONFIG_UAC_SAMPLE_RATE=16000
CONFIG_UAC_BIT_RESOLUTION_16=y
CONFIG_UAC_MIC_INTERVAL_MS=1
CONFIG_UAC_SUPPORT_MACOS=y
CONFIG_UAC_MIC_FIFO_DEPTH_MS=2
CONFIG_UAC_MIC_TASK_PRIORITY=7

# Bounded 5-second resource sampling; no all-task enumeration/formatting.
CONFIG_FREERTOS_GENERATE_RUN_TIME_STATS=y
CONFIG_FREERTOS_RUN_TIME_STATS_USING_ESP_TIMER=y
CONFIG_FREERTOS_RUN_TIME_COUNTER_TYPE_U32=y
```

## firmware/scepter/main/Kconfig.projbuild
```kconfig
menu "CytoScepter microphone audio"

    config MIC_OUTPUT_GAIN_X
        int "Default fixed microphone output gain multiplier"
        range 1 32
        default 16
        help
            Fixed digital gain applied after HPF/FIR/decimation and before the
            shared stereo soft limiter. The same value is applied to both
            microphone channels. A validated HID setting stored in NVS can
            override this default at runtime. This is not AGC.

endmenu
```
